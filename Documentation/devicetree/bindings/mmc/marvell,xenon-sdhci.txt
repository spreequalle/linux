## Documentation/devicetree/bindings/mmc/marvell,xenon-sdhci.txt
```
* Marvell's Xenon SDHCI Controller device tree bindings

Marvell Xenon SDHCI Controller is a SD/SDIO/MMC/eMMC host controller,
which can simultaneously support multiple SD/SDIO/MMC/eMMC cards.

This file documents differences between the core mmc properties
described by mmc.txt and the properties used by the Xenon implementation.

Required Properties:
- compatible: should be "marvell,xenon-sdhci"

- eMMC Speed Mode:
  If the SDHC slot in use is implemented to connect an eMMC card, three
  speed modes in below should be explicitly set.
  - mmc-ddr-1_8v
  - mmc-hs200-1_8v
  - mmc-hs400-1_8v
  Besides, since Xenon cannot support 1.2v, three speed modes in below
  should not be set.
  - mmc-ddr-1_2v
  - mmc-hs200-1_2v
  - mmc-hs400-1_2v
  If the SDHC slot is for SD/SDIO, eMMC speed mode should not be set.

- Slot Index
  Xenon can supports multiple slots in a single IP.
  Each SDHC slot has its own setting bits.
  The specific slot index in Xenon IP should be provided.
  - xenon,slotno = <slot_index>;

- Input Clock Name
  Some SOCs require additional clock for AXI bus.
  The input clock for Xenon IP core should be named as "core".
  The optional AXI clock should be named as "axi".
  - clocks = <&core_clk>, <&axi_clock>;
  - clock-names = "core", "axi";

- Register Set Size
  Different Xenon SDHC release has different register set size.
  The specific size should refer to the SOC implementation.

Optional Properties:
- eMMC Type Property
  Xenon SDHC eMMC slot requires some special initialization steps.
  In theory, driver can determine whether current Xenon slot is
  for eMMC by checking a register.
  However, SOC usually doesn't set that register in actual
  implementation. In this case, eMMC Type Property should be set.
  - xenon,emmc;

- Re-tuning Counter
  Xenon SDHC SOC usually doesn't provide re-tuning counter in
  Capabilities Register 3 Bit[11:8].
  This property provide the re-tuning counter.
  xenon,tuning-count = <count>;
  If this property is not set, default re-tuning counter will
  be set as 0x9 in driver.

- CMDQ Interrupt Coalescing Counter Threshold
  Only available when CMDQ feature is supported and
  CONFIG_MMC_XENON_SDHCI_CMDQ_WR_INT_COAL is enabled.
  The value is to set Interrupt Coalescing Counter Threshold
  in register Command Queuing Interrupt Coalescing Bit[12:8].
  The value range is between [0, 31].
  - xenon,cqe-iccth = <count>;

- CMDQ Interrupt Coalescing Timeout Value
  Only available when CMDQ feature is supported and
  CONFIG_MMC_XENON_SDHCI_CMDQ_WR_INT_COAL is enabled.
  The value is to set Interrupt Coalescing Timeout Value
  in register Command Queuing Interrupt Coalescing Bit[6:0].
  The value range is between [0x0, 0x7f].
  - xenon,cqe-ictoval = <count>;

- CMDQ SQS_TIMER
  Only available when CMDQ feature is supported.
  The value is to set Send Status Command Idle Timer in
  register Command Queuing Configuration 1 Bit[15:0].
  The value range is between [0x1, 0xFFFF].
  - xenon,cqe-sqstimer = <count>;
  If this property is not set, driver will use the default
  value in register Command Queuing Configuration 1.


Example:
- For eMMC slot:

	sdhci@aa0000 {
		compatible = "marvell,xenon-sdhci";
		reg = <0xaa0000 0x1000>;
		interrupts = <GIC_SPI 13 IRQ_TYPE_LEVEL_HIGH>
		clocks = <&emmcclk>;
		mmc-ddr-1_8v;
		mmc-hs200-1_8v;
		mmc-hs400-1_8v;
		non-removable;
		bus-width = <8>;
		tuning-count = <11>;
	};

- For SD/SDIO slot:

	sdhci@ab0000 {
		compatible = "marvell,xenon-sdhci";
		reg = <0xaa0000 0x1000>;
		interrupts = <GIC_SPI 55 IRQ_TYPE_LEVEL_HIGH>
		clocks = <&sdclk>;
		bus-width = <4>;
	}
```

## cameo/Kconfig
```kconfig
menu "Cameo Model Selection"

config SUPPORT_CAMEO_SDK
bool "Support Cameo Modification"

config SUPPORT_CONTROL_GPIO9
bool "Support users can control GPIO9 in UARTF_SHARE_MODE. Currently GPIO9 is always on by default."

config SUPPORT_TURN_POWER_LED_ON
bool "Support to turn the power led on while DUT is loading the kernel"

config POWER_LED_GPIO1
int 'GPIO1 for power led control'
depends on SUPPORT_TURN_POWER_LED_ON
default 9
	help
		This value is to indicate that which GPIO is used for the power led

config POWER_LED_GPIO2
int 'GPIO2 for power led control'
depends on SUPPORT_TURN_POWER_LED_ON
default 8
	help
		This value is to indicate that which GPIO is used for the power led

config SUPPORT_CONTROL_RESET_LED
bool "Support users can control flushing LED while pressing the reset button for reboot or restore to default"

config RESET_BTN_GPIO
int 'GPIO for reset button'
depends on SUPPORT_CONTROL_RESET_LED
default 10
	help
		This value is to indicate that which GPIO is used for the reset button

config SUPPORT_CONTROL_WLAN_LED_BY_STRENGTH
bool "Support flushing the wireless led by signal strength"

config SUPPORT_SILEX_SHAREPORT
bool "Support Silex shareport"

config SILEX_DEFAULT_MACHTYPE
string 'Allow users to set the Model Name which will show on the shareport utility'
depends on SUPPORT_SILEX_SHAREPORT
	help
		This value is to allow users to set the Model Name which will show on the shareport utility

config CFG_PART_SIZE
hex 'MTD CFG (DataBase) Partition Size (Unit:Bytes)'
default 0x20000
	help
	  This value is related to #define CFG_CONFIG_SIZE 0x30000 in rt2880.h in loader.

config SUPPORT_LANG_PART
bool "Add a extra Flash Partition for storing multiple language package"

config LANG_PART_SIZE
hex 'MTD Language Partition Size (Unit:Bytes)'
depends on SUPPORT_LANG_PART
default 0x40000
	help
	  This value is related to #define CFG_CONFIG_SIZE 0x70000 (0x30000 + 0x40000) in rt2880.h in loader.

config SUPPORT_POT_PART
bool "Add a extra Flash Partition for storing POT values"

config POT_PART_SIZE
hex 'POT Partition Size (Unit:Bytes)'
depends on SUPPORT_POT_PART
default 0x10000
	help
	  This value is related to POT partition size.

config SUPPORT_CHECKSUM_PART
bool "Add a extra Flash Partition for storing image's checksum"

config CHECKSUM_PART_SIZE
hex 'MTD CheckSum Size (Unit:Bytes)'
depends on SUPPORT_CHECKSUM_PART
default 0x10000
	help
	  This value is related to #define CHECKSUM_PART_SIZE in rt2880.h in loader.

config SUPPORT_INTELLON_POWER_SAVING
bool "To detect if there is a wireless client connects to DUT or not for Intellon Power Saving purpose"

choice

prompt "Choose Vendor"
config  DLINK
bool "D-LINK Models"
select DLINK_MODEL
endchoice

source "cameo/dlink/Kconfig"

config CAMEO_MODEL_NAME
	string
	default "DHP_W306AV" if DHP_W306AV
endmenu
```

## cameo/dlink/Kconfig
```kconfig
choice
	prompt "Choose Model"
	depends on DLINK
	default DHP_W306AV

config DHP_W306AV
	bool "DHP-W306AV"
	depends on DLINK
endchoice

config SUPPORT_DCC_HIJACK
bool "Support DCC hijack function"
depends on DLINK
default n
	help
		This value is to support to hijack DCC discovery packet

config SUPPORT_DLINK_LED_SPEC
bool "Support D-Link LED specification"
depends on DLINK
default y
	help
		This value is to support D-Link LED specification
		
config SUPPORT_DUAL_COLOR_POWER_LED
bool "Support the power led in dual color"
depends on SUPPORT_DLINK_LED_SPEC
default y
	help
		This value is to support D-Link LED specification

config DCC_MODEL_NAME
string 'the Model Name which is used in the response packet of DCC discovery'
depends on SUPPORT_DCC_HIJACK
	help
		This value is the Model Name which is used in the response packet of DCC discovery

config SUPPORT_PLC_MODULE
bool 'Support PLC module'
depends on SUPPORT_DCC_HIJACK
	help
		This value is to identify the model supports PLC module or not
		
config SUPPORT_NETWORK_KEY_HEX63
bool 'Support D-Link WPS requirement, the network key only supports 8 ~ 63 characters'
depends on DLINK
	help
		This value is to support D-Link WPS requirement, the network key only supports 8 ~ 63 characters
```

## drivers/pinctrl/berlin/Kconfig
```kconfig
if ARCH_BERLIN

config PINCTRL_BERLIN
	bool
	select PINMUX
	select REGMAP_MMIO

config PINCTRL_BERLIN_BG2
	bool
	select PINCTRL_BERLIN

config PINCTRL_BERLIN_BG2CD
	bool
	select PINCTRL_BERLIN

config PINCTRL_BERLIN_BG2Q
	bool
	select PINCTRL_BERLIN

config PINCTRL_BERLIN_BG4CD
	bool "Marvell Berlin BG4CD pin controller driver"
	select PINCTRL_BERLIN

config PINCTRL_BERLIN_BG4CDP
	bool "Marvell Berlin BG4CDP pin controller driver"
	select PINCTRL_BERLIN

config PINCTRL_BERLIN_BG4CT
	bool "Marvell Berlin BG4CT pin controller driver"
	select PINCTRL_BERLIN

endif
```

## drivers/soc/berlin/Kconfig
```kconfig
#
# berlin SoC drivers
#

source "drivers/soc/berlin/Kconfig.amp"

config BERLIN_CHIPID
	bool "Support BERLIN CHIPID"
	default y
	select SOC_BUS
	depends on ARCH_BERLIN || ARM64
	help
	  If you say Y here you get support for the BERLIN CHIP id.

config BERLIN_PXA3XX_NFC
	tristate "Support NAND Flash Controller (fork of pxa3xx_nand)"
	default n
	depends on ARCH_BERLIN
	select MTD
	select MTD_NAND
	help
	  A fork of mainline pxa3xx_nand.c. This NFC has no dedicated interrupt, but SoC
	  contains a powerfull pbridge DMA engine whose interrupt can be enabled/disabled.
	  So the driver could work in 3 modes: nonDMA, polling-DMA, interrupt-DMA.

config BERLIN_NAND_RANDOMIZER
	bool "Support software NAND randomizer"
	default n
	depends on BERLIN_PXA3XX_NFC
	help
	  To improve data stability for some large-capacity MLC(multipil-level cell) chips,
	  data have to be randomized before storing into, or
	  derandomized after reading out, from the physical cells.
	  For chips that don't build in HW randomizer, SW randomizer is needed.
	  Say Y here if you have no idea

config BERLIN_NAND_READ_RETRY
	bool "Support NAND read retry when ecc fail in read operation"
	default n
	depends on BERLIN_PXA3XX_NFC
	help
	  To improve nand read ability of error correction.When ecc fail in read operation,
	  change the read cmd parameter of nand chip. Every kind of Nand chip's READ RETRY feature
	  diff from each other.If nand chip do not support READ RETRY, this feature will do nothin.
	  Now support hynix nand chip read retry.

config BERLIN_GPU
	tristate "SoC's GPU support"
	default m
	help
	  2D and 3D GPU support

config BERLIN_AMP
	tristate "Support AMP"
	default m
	help
	  Enable support for AMP

config BERLIN_TZD
    tristate "Support New TrustZone"
    default m
    help
      Enable support for New ARM TrustZone


config BERLIN_TZDD
    tristate "Support TrustZone"
    select BERLIN_TZDD_CB
    default m
    help
      Enable support for Legacy ARM TrustZone

config BERLIN_TZDD_CB
    tristate "Support TrustZone Callback"
	depends on BERLIN_TZDD
    default m
    help
      Enable support for TrustZone event callback

config BERLIN_PWM
	bool "Support BERLIN PWM"
	default n
	help
	  Enable support for BERLIN PWM

config BERLIN_SM
	bool "Support SM CPU"
	default n
	help
	  Enable support for SM(System Manager) which is designed for front
	  panel control and power management.

config BERLIN_IR
	bool "Support Infra-Red remote controller"
	depends on BERLIN_SM
	default n
	help
	  Enable support for Infra-Red remote controller

config BERLIN_PPM
	tristate "Support Platform Power Management"
	default n
	depends on ARCH_BERLIN
	help
	  Profile based power management for Berlin platform

config BERLIN_MC6
	tristate "MC6 DDR Controller"
	default n
	depends on ARCH_BERLIN && OF
	help
	  This driver is for Marvell MC6 DDR Controller available on Marvell
	  Berlin SoCs.

config BERLIN_SDIO_WLAN_8887
	tristate "SDIO Wlan (IEEE802.11 A|B|G|N) driver for wlan8887 module"
	default n
	depends on MMC_SDHCI_PXAV3
	select WIRELESS_EXT
	select WEXT_PRIV
	select WEXT_SPY
	help
	  This is the wifi module for Berlin. Please try build it for module only.

config BERLIN_SDIO_BT_8887
	tristate "SDIO Bluetooth/BLE support for Marvell's 8887 SoC"
	default m
	help
	  This is defualt bluetooth module for Berlin based platform.

config BERLIN_SDIO_BT_CHAR_8897
	tristate "SDIO Bluetooth char device for bt8897 module"
	default n
	depends on MMC_SDHCI_PXAV3
	select WIRELESS_EXT
	select WEXT_PRIV
	select WEXT_SPY
	help
	  This is the bt char module for Berlin. Please try build it for module only.

config BERLIN_SDIO_WLAN_8897
	tristate "SDIO Wlan (IEEE802.11 A|B|G|N) driver for wlan8897 module"
	default n
	depends on MMC_SDHCI_PXAV3
	select WIRELESS_EXT
	select WEXT_PRIV
	select WEXT_SPY
	help
	  This is the wifi module for Berlin. Please try build it for module only.

config BERLIN_SDIO_BT_8897
	tristate "SDIO Bluetooth/BLE support for Marvell's 8897 SoC"
	default m
	help
	  This is the default bluetooth module for Berlin Platform.

config BERLIN_SDIO_BT_8997_CHAR_DRV
	tristate "SDIO Bluetooth char device for bt8997 module"
	default n
	help
	  This is the bt char module for Berlin. Please try build it for module only.

config BERLIN_SDIO_WLAN_8997
	tristate "SDIO Wlan (IEEE802.11 A|B|G|N) driver for wlan8997 module"
	default n
	depends on MMC_SDHCI_PXAV3
	select WIRELESS_EXT
	select WEXT_PRIV
	select WEXT_SPY
	help
	  This is the wifi module for Berlin. Please try build it for module only.

config BERLIN_SDIO_BT_8997
	tristate "SDIO Bluetooth/BLE support for Marvell's 8997 SoC"
	default n
	help
	  This is the default bluetooth module for Berlin Platform.

config BERLIN_SDIO_WLAN_8801
	tristate "SDIO Wlan (IEEE802.11 A|B|G|N) driver for wlan8801 module"
	default n
	depends on MMC_SDHCI_PXAV3
	select WIRELESS_EXT
	select WEXT_PRIV
	select WEXT_SPY
	help
	  This is the wifi module for Berlin. Please try build it for module only.
```

## drivers/soc/berlin/Kconfig.amp
```kconfig
#
# AMP variants
#

if ARCH_BERLIN

choice
	prompt "Marvell Berlin AMP Variants"
	default AMP_NONE

config AMP_NONE
	bool "Not select any chip variant in default"

config AMP_BERLIN_BG4CD
	bool "Marvell BG4CD"

config AMP_BERLIN_BG4CDP
	bool "Marvell BG4CDP"

endchoice

endif
```

## ralink/Kconfig
```kconfig
menu "Ralink Module"

###########
# Debuging
###########
source "drivers/net/rt_rdm/Kconfig"

#############
# Wire
#############
source "drivers/net/raeth/Kconfig"

#############
# Wireless
#############

config  RT2860V2_2850
        bool "Dual Band"
        depends on RALINK_RT2880

choice
        prompt "RF Type"
        depends on RALINK_RT3052
        default RALINK_RT3052_2T2R

        config  RALINK_RT3052_2T2R
        bool "RT3052-2T2R"
endchoice

choice
		prompt "WIFI Driver Version"
		config RT2860V2_2300_FinalN
		bool "Support Ralink WIFI driver RT2860v2 2.3.0.0 Final N"	
endchoice

#config INIC_USB
#bool
#default y if RT305x_INIC_USB

#config INIC_MII
#bool
#default y if RT2880v2_INIC_MII || RT305x_INIC_MII

#config INIC_PCI
#bool
#default y if RT2880v2_INIC_PCI

#choice
#prompt "Ralink NAT Type"
	
#config  RA_NAT_NONE
#bool "None"
#config  RA_NAT_HW
#bool "Hardware"
#endchoice

#source "net/nat/hw_nat/Kconfig"

endmenu
```
