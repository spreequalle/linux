/ {
	memory {
		reg = <0 0x02000000 0 0x0c000000>,
		      <0 0x0e800000 0 0x06800000>;
	};

	ion {
		compatible = "marvell,berlin-ion";
		marvell,ion-pool-num = <3>;
		reg = <0 0x0e800000 0 0x04000000>, <0 0x15000000 0 0x01000000>, <0 0x38000000 0 0x08000000>;
		reg-names = "NW_all", "NW_noncache", "SW_other";
		marvell,ion-attributes-num-per-pool = <2>;
		marvell,ion-pool-attributes = <0x00000002 0x00000F36 0x00000005 0x00000F3A 0x00000005 0x00000F3D>;
	};
};

&gpu {
	marvell,nonsecure-mem-base = <0 0x1e000000>;
	marvell,nonsecure-mem-size = <0 0x02000000>;
	marvell,phy-mem-size = <0 0x40000000>;
};
